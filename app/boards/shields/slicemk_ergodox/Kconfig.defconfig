## app/boards/shields/slicemk_ergodox/Kconfig.defconfig
```kconfig
if SHIELD_SLICEMK_ERGODOX_DONGLE || SHIELD_SLICEMK_ERGODOX_LEFTCENTRAL || SHIELD_SLICEMK_ERGODOX_LEFTSINGLE || SHIELD_SLICEMK_ERGODOX_LEFTPERIPHERAL || SHIELD_SLICEMK_ERGODOX_RIGHTCENTRAL || SHIELD_SLICEMK_ERGODOX_RIGHTSINGLE || SHIELD_SLICEMK_ERGODOX_RIGHTPERIPHERAL

config ZMK_BLE
    default y

endif

if SHIELD_SLICEMK_ERGODOX_DONGLE || SHIELD_SLICEMK_ERGODOX_LEFTCENTRAL || SHIELD_SLICEMK_ERGODOX_LEFTSINGLE || SHIELD_SLICEMK_ERGODOX_RIGHTCENTRAL || SHIELD_SLICEMK_ERGODOX_RIGHTSINGLE

config ZMK_USB
    default y

config ZMK_KEYBOARD_NAME
    default "SliceMK ErgoDox"

endif

if SHIELD_SLICEMK_ERGODOX_DONGLE || SHIELD_SLICEMK_ERGODOX_LEFTCENTRAL || SHIELD_SLICEMK_ERGODOX_RIGHTCENTRAL

config ZMK_SPLIT
    default y

config ZMK_SPLIT_ROLE_CENTRAL
    default y

endif

if SHIELD_SLICEMK_ERGODOX_DONGLE

config ZMK_SPLIT_BLE_CENTRAL_PERIPHERALS
    default 2

config BT_MAX_PAIRED
    default 7

config BT_MAX_CONN
    default 7

endif

if SHIELD_SLICEMK_ERGODOX_LEFTPERIPHERAL || SHIELD_SLICEMK_ERGODOX_RIGHTPERIPHERAL

config ZMK_SPLIT
    default y

endif
```

## app/west.yml
```yaml
manifest:
  remotes:
    - name: zephyrproject-rtos
      url-base: https://github.com/zephyrproject-rtos
    - name: zmkfirmware
      url-base: https://github.com/zmkfirmware
  projects:
    - name: zephyr
      remote: zmkfirmware
      revision: v3.5.0+zmk-fixes
      clone-depth: 1
      import:
        name-whitelist:
          # Zephyr modules for building firmware
          - cmsis
          - hal_nordic
          - hal_rpi_pico
          - lvgl
          - segger
          - tinycrypt
          - zcbor
          # Babblesim modules for testing
          - bsim
          - babblesim_base
          - babblesim_ext_2G4_libPhyComv1
          - babblesim_ext_2G4_phy_v1
          - babblesim_ext_2G4_channel_NtNcable
          - babblesim_ext_2G4_channel_multiatt
          - babblesim_ext_2G4_modem_magic
          - babblesim_ext_2G4_modem_BLE_simple
          - babblesim_ext_2G4_device_burst_interferer
          - babblesim_ext_2G4_device_WLAN_actmod
          - babblesim_ext_2G4_device_playback
          - babblesim_ext_libCryptov1
          - nrf_hw_models
  self:
    west-commands: scripts/west-commands.yml
```
